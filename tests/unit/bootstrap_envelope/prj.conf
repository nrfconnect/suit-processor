## CMakeLists.txt
```
#
# Copyright (c) 2023 Nordic Semiconductor ASA
#
# SPDX-License-Identifier: Apache-2.0
#

cmake_minimum_required(VERSION 3.20.0)

find_package(Zephyr REQUIRED HINTS $ENV{ZEPHYR_BASE})

project(unit_test_bootstrap_envelope)
include(../../cmake/test_template.cmake)
add_subdirectory("${CMAKE_CURRENT_LIST_DIR}/../common" "${PROJECT_BINARY_DIR}/test_common")

# generate runner for the test
test_runner_generate(src/main.c)

# create mocks for suit_platform functions
cmock_handle(${SUIT_PROCESSOR_DIR}/include/suit_platform.h suit_platform)

target_include_directories(app PRIVATE include)

target_link_libraries(app PRIVATE zephyr_interface)

# Link app with bootstrap_envelope library
target_link_libraries(app PUBLIC bootstrap_envelope)
```

## prj.conf
```kconfig
#
# Copyright (c) 2023 Nordic Semiconductor ASA
#
# SPDX-License-Identifier: Apache-2.0
#

CONFIG_UNITY=y
CONFIG_MAIN_STACK_SIZE=2048
CONFIG_NO_OPTIMIZATIONS=y
```

## src/main.c
```c
/*
 * Copyright (c) 2023 Nordic Semiconductor ASA
 *
 * SPDX-License-Identifier: LicenseRef-Nordic-5-Clause
 */

#include <unity.h>
#include <suit.h>
#include <bootstrap_envelope.h>
#include "suit_platform/cmock_suit_platform.h"


static struct suit_processor_state state;


void test_bootstrap_reset_state(void)
{
	suit_reset_state(&state);
}

void test_bootstrap_empty_envelope(void)
{
	bootstrap_envelope_empty(&state);
	bootstrap_envelope_components(&state, 0);

	int retval = suit_process_manifest(&state, SUIT_VALIDATE);
	TEST_ASSERT_EQUAL(SUIT_ERR_UNAVAILABLE_COMMAND_SEQ, retval);
}

void test_bootstrap_empty_sequence(void)
{
	struct zcbor_string empty_seq = {
		.value = NULL,
		.len = 0,
	};

	bootstrap_envelope_empty(&state);
	bootstrap_envelope_sequence(&state, SUIT_VALIDATE, &empty_seq);
	/* If a manifest contains more than one component, it is required to start
	 * each sequence with set-component-index.
	 * Use special value (1) to skip this check.
	 */
	bootstrap_envelope_components(&state, 1);

	int retval = suit_process_manifest(&state, SUIT_VALIDATE);
	TEST_ASSERT_EQUAL(ZCBOR_ERR_TO_SUIT_ERR(ZCBOR_ERR_NO_PAYLOAD), retval);
}

void test_bootstrap_invoke_no_components(void)
{
	uint8_t invoke_cmd[] = {
		0x82, /* list (2 elements - 1 command) */
		0x17, /* uint(suit-directive-invoke) */
		0x00, /* uint(SUIT_Rep_Policy::None) */
	};
	struct zcbor_string invoke_seq = {
		.value = invoke_cmd,
		.len = sizeof(invoke_cmd),
	};

	bootstrap_envelope_empty(&state);
	bootstrap_envelope_sequence(&state, SUIT_INVOKE, &invoke_seq);
	bootstrap_envelope_components(&state, 0);

	int retval = suit_process_manifest(&state, SUIT_INVOKE);
	TEST_ASSERT_EQUAL(SUIT_ERR_MANIFEST_VALIDATION, retval);
}

void test_bootstrap_invoke_single_component(void)
{
	uint8_t invoke_cmd[] = {
		0x82, /* list (2 elements - 1 command) */
			0x17, /* uint(suit-directive-invoke) */
			0x00, /* uint(SUIT_Rep_Policy::None) */
	};
	struct zcbor_string invoke_seq = {
		.value = invoke_cmd,
		.len = sizeof(invoke_cmd),
	};

	bootstrap_envelope_empty(&state);
	bootstrap_envelope_sequence(&state, SUIT_INVOKE, &invoke_seq);
	bootstrap_envelope_components(&state, 1);

	__cmock_suit_plat_invoke_ExpectAndReturn(ASSIGNED_COMPONENT_HANDLE, NULL, SUIT_SUCCESS);
	__cmock_suit_plat_sequence_completed_ExpectAndReturn(SUIT_INVOKE, NULL, NULL, 0, SUIT_SUCCESS);

	int retval = suit_process_manifest(&state, SUIT_INVOKE);
	TEST_ASSERT_EQUAL(SUIT_SUCCESS, retval);
}


/* It is required to be added to each test. That is because unity is using
 * different main signature (returns int) and zephyr expects main which does
 * not return value.
 */
extern int unity_main(void);

void main(void)
{
	(void)unity_main();
}
```
