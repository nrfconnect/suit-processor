## CMakeLists.txt
```
#
# Copyright (c) 2022 Nordic Semiconductor ASA
#
# SPDX-License-Identifier: LicenseRef-Nordic-5-Clause
#

cmake_minimum_required(VERSION 3.20.0)

find_package(Zephyr REQUIRED HINTS $ENV{ZEPHYR_BASE})

project(unit_test_fetch_integrated_payload)
include(../../cmake/test_template.cmake)
add_subdirectory("${CMAKE_CURRENT_LIST_DIR}/../common" "${PROJECT_BINARY_DIR}/test_common")

# generate runner for the test
test_runner_generate(src/main.c)

# create mocks for suit_platform functions
cmock_handle(${SUIT_PROCESSOR_DIR}/include/suit_platform.h suit_platform)

target_include_directories(app PRIVATE include)

target_link_libraries(app PRIVATE zephyr_interface)

# Link app with complex arg library
target_link_libraries(app PUBLIC complex_arg)
```

## prj.conf
```kconfig
#
# Copyright (c) 2022 Nordic Semiconductor ASA
#
# SPDX-License-Identifier: LicenseRef-Nordic-5-Clause
#

CONFIG_UNITY=y
CONFIG_MAIN_STACK_SIZE=2048
CONFIG_NO_OPTIMIZATIONS=y
```

## src/main.c
```c
/*
 * Copyright (c) 2022 Nordic Semiconductor ASA
 *
 * SPDX-License-Identifier: LicenseRef-Nordic-5-Clause
 */

#include <unity.h>
#include <stdint.h>
#include "suit.h"
#include "suit_platform/cmock_suit_platform.h"
#include "suit_platform_mock_ext.h"

#define ASSIGNED_COMPONENT_HANDLE 0x1E054000


extern uint8_t manifest_buf[];
extern const size_t manifest_len;


static struct zcbor_string signature = {
	.value = &(manifest_buf[57]),
	.len = 64,
};
static uint8_t signature1_cbor[] = {
	0x84, // Sig_structure1: array(4)
		0x6A, // context: text(10)
			'S', 'i', 'g', 'n', 'a', 't', 'u', 'r', 'e', '1',
		0x43, // body_protected: bytes(3)
			0xA1, // header_map: map(1)
				0x01, // alg_id: 1
					0x26, // ES256: -7
		0x40, // external_aad: bytes(0)
		0x58, // payload: bytes(36)
			0x24, 0x82, 0x2F, 0x58, 0x20,
			0xAD, 0xD7, 0xDD, 0x3E, 0x37, 0x4D, 0x38, 0xF3,
			0x8A, 0x7E, 0x4F, 0xF2, 0x60, 0x12, 0x42, 0xAA,
			0x2D, 0xF2, 0x46, 0x3B, 0x8F, 0xEC, 0xA3, 0x60,
			0xEA, 0x37, 0x5F, 0x50, 0xEA, 0xB3, 0xBF, 0x7D,
};
static struct zcbor_string exp_signature = {
	.value = signature1_cbor,
	.len = sizeof(signature1_cbor),
};

static uint8_t manifest_digest[] = {
	0xAD, 0xD7, 0xDD, 0x3E, 0x37, 0x4D, 0x38, 0xF3,
	0x8A, 0x7E, 0x4F, 0xF2, 0x60, 0x12, 0x42, 0xAA,
	0x2D, 0xF2, 0x46, 0x3B, 0x8F, 0xEC, 0xA3, 0x60,
	0xEA, 0x37, 0x5F, 0x50, 0xEA, 0xB3, 0xBF, 0x7D,
};
static struct zcbor_string exp_manifest_digest = {
	.value = manifest_digest,
	.len = sizeof(manifest_digest),
};
static struct zcbor_string exp_manifest_payload = {
	.value = &(manifest_buf[122]),
	.len = 176,
};

static struct zcbor_string exp_manifest_id = {
	.value = NULL,
	.len = 0,
};

static uint8_t vid_uuid[] = {
	0x76, 0x17, 0xDA, 0xA5, 0x71, 0xFD, 0x5A, 0x85, /* RFC4122_UUID(nordicsemi.com) */
	0x8F, 0x94, 0xE2, 0x8D, 0x73, 0x5C, 0xE9, 0xF4,
};
static struct zcbor_string exp_vid_uuid = {
	.value = vid_uuid,
	.len = sizeof(vid_uuid),
};

static uint8_t cid_uuid[] = {
	0xD6, 0x22, 0xBA, 0xFD, 0x43, 0x37, 0x51, 0x85,
	0x90, 0xBC, 0x63, 0x68, 0xCD, 0xA7, 0xFB, 0xCA,
};
static struct zcbor_string exp_cid_uuid = {
	.value = cid_uuid,
	.len = sizeof(cid_uuid),
};

static uint8_t image_digest[] = {
	0x5F, 0xC3, 0x54, 0xBF, 0x8E, 0x8C, 0x50, 0xFB,
	0x4F, 0xBC, 0x2C, 0xFA, 0xEB, 0x04, 0x53, 0x41,
	0xC9, 0x80, 0x6D, 0xEA, 0xBD, 0xCB, 0x41, 0x54,
	0xFB, 0x79, 0xCC, 0xA4, 0xF0, 0xC9, 0x8C, 0x12,
};
static struct zcbor_string exp_image_digest = {
	.value = image_digest,
	.len = sizeof(image_digest),
};
static struct zcbor_string exp_image_payload = {
	.value = &manifest_buf[451],
	.len = 256,
};

static uint8_t text_digest[] = {
	0x4E, 0xDC, 0x09, 0xC1, 0x4D, 0x19, 0xF1, 0x56,
	0x0C, 0x9A, 0xCE, 0x62, 0x64, 0xA5, 0x3D, 0x86,
	0xF8, 0x90, 0x73, 0x70, 0x49, 0x94, 0x63, 0x48,
	0x77, 0x00, 0x7F, 0x1E, 0x04, 0x27, 0x2E, 0xE5,
};
static struct zcbor_string exp_text_digest = {
	.value = text_digest,
	.len = sizeof(text_digest),
};
static struct zcbor_string exp_text_payload = {
	.value = &(manifest_buf[299]),
	.len = 140,
};



static void assert_envelope_authorization(void)
{
	/* The envelope authorization should:
	 * - Verify that the manifest digest matches with the manifest contents
	 * - Verify the manifest signature
	 * - Verify the severable fields digest
	 */
	__cmock_suit_plat_check_digest_ExpectComplexArgsAndReturn(suit_cose_sha256, &exp_manifest_digest, &exp_manifest_payload, SUIT_SUCCESS);
	__cmock_suit_plat_authenticate_manifest_ExpectComplexArgsAndReturn(&exp_manifest_id, suit_cose_es256, NULL, &signature, &exp_signature, SUIT_SUCCESS);
	__cmock_suit_plat_check_digest_ExpectComplexArgsAndReturn(suit_cose_sha256, &exp_text_digest, &exp_text_payload, SUIT_SUCCESS);
}

static void assert_component_creation(void)
{
	static suit_component_t component_handle = ASSIGNED_COMPONENT_HANDLE;
	static uint8_t app_id[] = {
		0x82, // SUIT_Component_Identifier: array(2)
			0x41, // bstr: bytes(1)
				'X',
			0x44, // bstr: bytes(4)
				0x1E, 0x05, 0x40, 0x00,
	};
	static struct zcbor_string exp_component_id = {
		.value = app_id,
		.len = sizeof(app_id),
	};

	__cmock_suit_plat_authorize_component_id_ExpectComplexArgsAndReturn(&exp_manifest_id, &exp_component_id, SUIT_SUCCESS);
	__cmock_suit_plat_create_component_handle_ExpectComplexArgsAndReturn(&exp_component_id, false, NULL, SUIT_SUCCESS);
	__cmock_suit_plat_create_component_handle_IgnoreArg_handle();
	__cmock_suit_plat_create_component_handle_ReturnThruPtr_handle(&component_handle);

	/* clean-up */
	__cmock_suit_plat_release_component_handle_ExpectAndReturn(component_handle, SUIT_SUCCESS);
}

#ifdef SUIT_PLATFORM_DRY_RUN_SUPPORT
static void assert_dry_run_execution(void)
{
	__cmock_suit_plat_check_fetch_integrated_ExpectComplexArgsAndReturn(ASSIGNED_COMPONENT_HANDLE, &exp_image_payload, SUIT_SUCCESS);
	__cmock_suit_plat_check_invoke_ExpectAndReturn(ASSIGNED_COMPONENT_HANDLE, NULL, SUIT_SUCCESS);
}
#endif /* SUIT_PLATFORM_DRY_RUN_SUPPORT */


void setUp(void)
{
	int ret = suit_processor_init();
	TEST_ASSERT_EQUAL_MESSAGE(SUIT_SUCCESS, ret, "Unable to initialize SUIT processor");

	TEST_ASSERT_EQUAL_MEMORY_MESSAGE(&(signature1_cbor[23]), manifest_digest, sizeof(manifest_digest), "Please fix the test: manifest digest inside signature structure is incorrect");
}

void test_suit_decode_envelope(void)
{
	struct zcbor_string manifest_component_id;
	struct zcbor_string digest;
	enum suit_cose_alg alg;
	unsigned int seq_num;

	__cmock_suit_plat_check_digest_ExpectComplexArgsAndReturn(suit_cose_sha256, &exp_manifest_digest, &exp_manifest_payload, SUIT_SUCCESS);

	/* The envelope decoding is fully handled by the ZCBOR code and does not call platform APIs */
	int ret = suit_processor_get_manifest_metadata(
		manifest_buf, manifest_len, false,
		&manifest_component_id, NULL, NULL, &digest, &alg, &seq_num);

	TEST_ASSERT_EQUAL_MESSAGE(SUIT_SUCCESS, ret, "Unable to decode input manifest");
	TEST_ASSERT_EQUAL_MESSAGE(1, seq_num, "Unexpected sequence number value");
	TEST_ASSERT_EQUAL_MESSAGE(suit_cose_sha256, alg, "Unexpected digest algorithm ID value");
	assert_zcbor_string(&exp_manifest_id, &manifest_component_id);
	assert_zcbor_string(&exp_manifest_digest, &digest);
}

void test_suit_process_seq_invald(void)
{
	/* SUIT_SEQ_INVALID is not a valid step - it serves as a boundary value of the enum. */
	int err = suit_process_sequence(manifest_buf, manifest_len, SUIT_SEQ_INVALID);
	TEST_ASSERT_EQUAL(SUIT_ERR_UNAVAILABLE_COMMAND_SEQ, err);
}

void test_suit_process_seq_parse(void)
{
	assert_envelope_authorization();
	assert_component_creation();
#ifdef SUIT_PLATFORM_DRY_RUN_SUPPORT
	assert_dry_run_execution();
#endif /* SUIT_PLATFORM_DRY_RUN_SUPPORT */

	__cmock_suit_plat_authorize_sequence_num_ExpectAndReturn(SUIT_SEQ_PARSE, &exp_manifest_id, 1, SUIT_SUCCESS);

	int err = suit_process_sequence(manifest_buf, manifest_len, SUIT_SEQ_PARSE);
	TEST_ASSERT_EQUAL(SUIT_SUCCESS, err);
}

void test_suit_process_seq_payload_fetch(void)
{
	/* SUIT_SEQ_PAYLOAD_FETCH command sequence is not present in the sample manifest.
	 * The internal payload is fetched to the executable slot by executing FETCH command
	 * from the INSTALL step.
	 */
	assert_envelope_authorization();
	assert_component_creation();
#ifdef SUIT_PLATFORM_DRY_RUN_SUPPORT
	assert_dry_run_execution();
#endif /* SUIT_PLATFORM_DRY_RUN_SUPPORT */

	__cmock_suit_plat_authorize_sequence_num_ExpectAndReturn(SUIT_SEQ_PAYLOAD_FETCH, &exp_manifest_id, 1, SUIT_SUCCESS);

	int err = suit_process_sequence(manifest_buf, manifest_len, SUIT_SEQ_PAYLOAD_FETCH);
	TEST_ASSERT_EQUAL(SUIT_ERR_UNAVAILABLE_COMMAND_SEQ, err);
}

static int authorize_sequence_num_callback(enum suit_command_sequence seq_name, struct zcbor_string *manifest_component_id, unsigned int seq_num, int cmock_num_calls)
{
	static uint8_t minimal_manifest[] = {
		0xd8, 0x6b, 0xa2, 0x02, 0x58, 0x7a, 0x82, 0x58, 0x24, 0x82, 0x2f, 0x58, 0x20, 0xfd, 0xf6,
		0x82, 0x8c, 0x9a, 0xd7, 0xf8, 0x57, 0xc5, 0x66, 0xaa, 0xd3, 0x4c, 0xc1, 0x7c, 0x28, 0xb4,
		0x5a, 0x07, 0x90, 0xf2, 0xa0, 0x06, 0x37, 0x67, 0x26, 0xf2, 0xf4, 0x50, 0x81, 0xb6, 0x37,
		0x58, 0x51, 0xd2, 0x84, 0x4a, 0xa2, 0x01, 0x26, 0x04, 0x45, 0x1a, 0x7f, 0xff, 0xff, 0xe0,
		0xa0, 0xf6, 0x58, 0x40, 0x34, 0x7b, 0x7c, 0xac, 0x27, 0x3e, 0x72, 0xb7, 0xc0, 0x0d, 0x7b,
		0x0d, 0x35, 0x33, 0xfa, 0xb4, 0x4b, 0xb4, 0x45, 0x8c, 0xe5, 0xd4, 0x51, 0xe0, 0xeb, 0x4b,
		0x27, 0xa7, 0xd2, 0x3f, 0x69, 0x63, 0x7f, 0xdc, 0x03, 0x52, 0xd2, 0x1f, 0x79, 0x0c, 0x61,
		0x9c, 0xa1, 0xb8, 0x18, 0x91, 0xc0, 0x97, 0x0f, 0xb5, 0x5c, 0xdf, 0x14, 0x92, 0xbd, 0x92,
		0x66, 0xba, 0xa4, 0xe0, 0x35, 0x84, 0x5c, 0xd0, 0x03, 0x58, 0x19, 0xa3, 0x01, 0x01, 0x02,
		0x0c, 0x03, 0x52, 0xa1, 0x02, 0x81, 0x84, 0x41, 0x4d, 0x41, 0x00, 0x45, 0x1a, 0x00, 0x08,
		0x00, 0x00, 0x43, 0x19, 0x10, 0x00
	};
	/* It must be possible to decode a different manifest from the sequence completion callback. */
	unsigned int seq_num_minimal;

	static uint8_t minimal_manifest_digest[] = {
		0xfd, 0xf6, 0x82, 0x8c, 0x9a, 0xd7, 0xf8, 0x57,
		0xc5, 0x66, 0xaa, 0xd3, 0x4c, 0xc1, 0x7c, 0x28,
		0xb4, 0x5a, 0x07, 0x90, 0xf2, 0xa0, 0x06, 0x37,
		0x67, 0x26, 0xf2, 0xf4, 0x50, 0x81, 0xb6, 0x37,
	};
	static struct zcbor_string exp_minimal_manifest_digest = {
		.value = minimal_manifest_digest,
		.len = sizeof(minimal_manifest_digest),
	};
	static struct zcbor_string exp_minimal_manifest_payload = {
		.value = &minimal_manifest[129],
		.len = 27,
	};
	__cmock_suit_plat_check_digest_ExpectComplexArgsAndReturn(suit_cose_sha256, &exp_minimal_manifest_digest, &exp_minimal_manifest_payload, SUIT_SUCCESS);

	/* The envelope decoding is fully handled by the ZCBOR code and does not call platform APIs */
	int ret = suit_processor_get_manifest_metadata(
		minimal_manifest, sizeof(minimal_manifest), false,
		NULL, NULL, NULL, NULL, NULL, &seq_num_minimal);

	TEST_ASSERT_EQUAL_MESSAGE(SUIT_SUCCESS, ret, "Unable to decode input manifest");
	TEST_ASSERT_EQUAL_MESSAGE(12, seq_num_minimal, "Unexpected sequence number value");

	return SUIT_SUCCESS;
}


void test_suit_process_seq_install(void)
{
	/* SUIT_SEQ_INSTALL should:
	 * - execute the shared sequence (VID and CID checks),
	 * - copy the integrated payload into executable slot through FETCH (integrated) command
	 * - verify the image digest in the executable slot
	 */
	assert_envelope_authorization();
	assert_component_creation();
#ifdef SUIT_PLATFORM_DRY_RUN_SUPPORT
	assert_dry_run_execution();
#endif /* SUIT_PLATFORM_DRY_RUN_SUPPORT */

	__cmock_suit_plat_authorize_sequence_num_ExpectAndReturn(SUIT_SEQ_INSTALL, &exp_manifest_id, 1, SUIT_SUCCESS);
	__cmock_suit_plat_authorize_sequence_num_AddCallback(authorize_sequence_num_callback);
	__cmock_suit_plat_override_image_size_ExpectAndReturn(ASSIGNED_COMPONENT_HANDLE, 256, &exp_manifest_id, SUIT_SUCCESS);
	__cmock_suit_plat_check_vid_ExpectComplexArgsAndReturn(ASSIGNED_COMPONENT_HANDLE, &exp_vid_uuid, SUIT_SUCCESS);
	__cmock_suit_plat_check_cid_ExpectComplexArgsAndReturn(ASSIGNED_COMPONENT_HANDLE, &exp_cid_uuid, SUIT_SUCCESS);
	__cmock_suit_plat_fetch_integrated_ExpectComplexArgsAndReturn(ASSIGNED_COMPONENT_HANDLE, &exp_image_payload, &exp_manifest_id, NULL, SUIT_SUCCESS);
	__cmock_suit_plat_check_image_match_ExpectComplexArgsAndReturn(ASSIGNED_COMPONENT_HANDLE, suit_cose_sha256, &exp_image_digest, SUIT_SUCCESS);
	__cmock_suit_plat_sequence_completed_ExpectAndReturn(SUIT_SEQ_INSTALL, &exp_manifest_id, manifest_buf, manifest_len, SUIT_SUCCESS);

	int err = suit_process_sequence(manifest_buf, manifest_len, SUIT_SEQ_INSTALL);
	TEST_ASSERT_EQUAL(SUIT_SUCCESS, err);
}

void test_suit_process_seq_validate(void)
{
	/* SUIT_SEQ_VALIDATE should:
	 * - execute the shared sequence (VID and CID checks)
	 * - verify the image digest in the executable slot.
	 */
	assert_envelope_authorization();
	assert_component_creation();
#ifdef SUIT_PLATFORM_DRY_RUN_SUPPORT
	assert_dry_run_execution();
#endif /* SUIT_PLATFORM_DRY_RUN_SUPPORT */

	__cmock_suit_plat_authorize_sequence_num_ExpectAndReturn(SUIT_SEQ_VALIDATE, &exp_manifest_id, 1, SUIT_SUCCESS);
	__cmock_suit_plat_override_image_size_ExpectAndReturn(ASSIGNED_COMPONENT_HANDLE, 256, &exp_manifest_id, SUIT_SUCCESS);
	__cmock_suit_plat_check_vid_ExpectComplexArgsAndReturn(ASSIGNED_COMPONENT_HANDLE, &exp_vid_uuid, SUIT_SUCCESS);
	__cmock_suit_plat_check_cid_ExpectComplexArgsAndReturn(ASSIGNED_COMPONENT_HANDLE, &exp_cid_uuid, SUIT_SUCCESS);
	__cmock_suit_plat_check_image_match_ExpectComplexArgsAndReturn(ASSIGNED_COMPONENT_HANDLE, suit_cose_sha256, &exp_image_digest, SUIT_SUCCESS);
	__cmock_suit_plat_sequence_completed_ExpectAndReturn(SUIT_SEQ_VALIDATE, &exp_manifest_id, manifest_buf, manifest_len, SUIT_SUCCESS);

	int err = suit_process_sequence(manifest_buf, manifest_len, SUIT_SEQ_VALIDATE);
	TEST_ASSERT_EQUAL(SUIT_SUCCESS, err);
}

void test_suit_process_seq_load(void)
{
	/* SUIT_SEQ_LOAD command sequence is not present in the sample manifest. */
	assert_envelope_authorization();
	assert_component_creation();
#ifdef SUIT_PLATFORM_DRY_RUN_SUPPORT
	assert_dry_run_execution();
#endif /* SUIT_PLATFORM_DRY_RUN_SUPPORT */

	__cmock_suit_plat_authorize_sequence_num_ExpectAndReturn(SUIT_SEQ_LOAD, &exp_manifest_id, 1, SUIT_SUCCESS);

	int err = suit_process_sequence(manifest_buf, manifest_len, SUIT_SEQ_LOAD);
	TEST_ASSERT_EQUAL(SUIT_ERR_UNAVAILABLE_COMMAND_SEQ, err);
}

void test_suit_process_seq_invoke(void)
{
	/* SUIT_SEQ_INVOKE should:
	 * - execute the shared sequence (VID and CID checks)
	 * - execute the INVOKE command.
	 * The image validity is expected to be checked in the SUIT_VALIDATE step.
	 */
	assert_envelope_authorization();
	assert_component_creation();
#ifdef SUIT_PLATFORM_DRY_RUN_SUPPORT
	assert_dry_run_execution();
#endif /* SUIT_PLATFORM_DRY_RUN_SUPPORT */

	__cmock_suit_plat_authorize_sequence_num_ExpectAndReturn(SUIT_SEQ_INVOKE, &exp_manifest_id, 1, SUIT_SUCCESS);
	__cmock_suit_plat_override_image_size_ExpectAndReturn(ASSIGNED_COMPONENT_HANDLE, 256, &exp_manifest_id, SUIT_SUCCESS);
	__cmock_suit_plat_check_vid_ExpectComplexArgsAndReturn(ASSIGNED_COMPONENT_HANDLE, &exp_vid_uuid, SUIT_SUCCESS);
	__cmock_suit_plat_check_cid_ExpectComplexArgsAndReturn(ASSIGNED_COMPONENT_HANDLE, &exp_cid_uuid, SUIT_SUCCESS);
	__cmock_suit_plat_invoke_ExpectAndReturn(ASSIGNED_COMPONENT_HANDLE, NULL, SUIT_SUCCESS);
	__cmock_suit_plat_sequence_completed_ExpectAndReturn(SUIT_SEQ_INVOKE, &exp_manifest_id, manifest_buf, manifest_len, SUIT_SUCCESS);

	int err = suit_process_sequence(manifest_buf, manifest_len, SUIT_SEQ_INVOKE);
	TEST_ASSERT_EQUAL(SUIT_SUCCESS, err);
}

void test_suit_process_seq_max(void)
{
	/* SUIT_SEQ_MAX is not a valid step - it serves as a boundary value of the enum. */
	int err = suit_process_sequence(manifest_buf, manifest_len, SUIT_SEQ_MAX);
	TEST_ASSERT_EQUAL(SUIT_ERR_UNAVAILABLE_COMMAND_SEQ, err);
}


/* It is required to be added to each test. That is because unity's
 * main may return nonzero, while zephyr's main currently must
 * return 0 in all cases (other values are reserved).
 */
extern int unity_main(void);

int main(void)
{
	(void)unity_main();

	return 0;
}
```

## include/suit_platform_mock_ext.h
```c
/*
 * Copyright (c) 2022 Nordic Semiconductor ASA
 *
 * SPDX-License-Identifier: LicenseRef-Nordic-5-Clause
 */

#include "suit_platform/cmock_suit_platform.h"
#include <complex_arg.h>

#ifndef _SUIT_PLATFORM_MOCK_EXT_H
#define _SUIT_PLATFORM_MOCK_EXT_H

/** @file suit_platform_mock_ext.h
 * @brief Provides additional CMock-like functions that assert on the zcbor string contents.
 *
 * The CMock provides two main prototypes for checking the set of arguments, passed to the mocked APIs:
 *  - __cmock_<API>_ExpectArgsAndReturn(args..): that compare directly the values with the expected arguments
 *  - __cmock_<API>_ExpectWithArrayAndReturn(args.., *args..): that compare pointer arguments against an expected, pointed memory contents
 *
 * In case of pointers to ZCBOR strings, defined as the following structure:
 * struct zcbor_string {
 *     const uint8_t *value;
 *     size_t len;
 * };
 *
 * both of them are insufficient:
 *  - __cmock_<API>_ExpectArgsAndReturn(args..): will assert on the pointer to the structure,
 *    which usually points to the local variable, thus the address is unpredictable.
 *  - __cmock_<API>_ExpectWithArrayAndReturn(args.., *args..): will correctly verify the `len` field,
 *    but instead of checking value, pointed by the `value` field, it will assert on the pointed address.
 *    In most cases, it will be predictable, because the SUIT module passes pointers to the manifest buffer,
 *    but this is not true for checking temporary buffers, for example the Signature1 authentication block.
 *
 * To overcome this limitation, a complex_arg queues are used. They allow to:
 *  - Store the expected argument value with a custom assertion function on the queue through push_complex_arg(..) API
 *  - Store the expected return value on the queue through push_retval_arg API
 *  - Pop the queue head and execute the assertion using the assert_complex_arg(..) API
 *
 * To mix complex and non-complex argument types, the regular __cmock_<API>_ExpectArgsAndReturn(args..)
 * functions are used, but for each complex argument:
 *  - The queue is populated
 *  - The __cmock_<API>_IgnoreArg_<complex_arg_name> API is called
 * In addition to that:
 *  - A callback for running queue-based assertions is registered
 *  - The return value, expected to be returned by callback is added to the queue
 *
 * The implementation for those extensions should:
 * - Define queues for storing complex arguments, one for each mock using COMPLEX_ARG_Q_DEFINE(..) API.
 * - Implement the registered callbacks.
 *
 * Note: The generation of the CMock functions is requested by calling cmock_handle(<module.h> <module_subdir>)
 *       CMake function and the auto-generated functions are placed inside the build/mocks/<module_subdir> directory.
 */


/** @brief assert if length and values of two ZCBOR string differ.
 *
 * @param p1  Pointer to the first ZCBOR string.
 * @param p2  Pointer to the second ZCBOR string.
 */
void assert_zcbor_string(void *p1, void *p2);

#define __cmock_suit_plat_check_digest_ExpectComplexArgsAndReturn(alg_id, digest, payload, cmock_retval) { \
	extern complex_arg_q_t __check_digest_callback_queue; \
	push_complex_arg(digest, assert_zcbor_string, __check_digest_callback_queue); \
	push_complex_arg(payload, assert_zcbor_string, __check_digest_callback_queue); \
	push_retval_arg(cmock_retval, __check_digest_callback_queue); \
	__cmock_suit_plat_check_digest_AddCallback(__check_digest_callback); \
	__cmock_suit_plat_check_digest_ExpectAndReturn(alg_id, digest, payload, cmock_retval); \
	__cmock_suit_plat_check_digest_IgnoreArg_digest(); \
	__cmock_suit_plat_check_digest_IgnoreArg_payload(); \
}
int __check_digest_callback(enum suit_cose_alg alg_id, struct zcbor_string *digest, struct zcbor_string *payload, int cmock_num_calls);

#define __cmock_suit_plat_authenticate_manifest_ExpectComplexArgsAndReturn(manifest_component_id, alg_id, key_id, signature, data, cmock_retval) { \
	extern complex_arg_q_t __authenticate_manifest_callback_queue; \
	push_complex_arg(manifest_component_id, assert_zcbor_string, __authenticate_manifest_callback_queue); \
	push_complex_arg(key_id, assert_zcbor_string, __authenticate_manifest_callback_queue); \
	push_complex_arg(signature, assert_zcbor_string, __authenticate_manifest_callback_queue); \
	push_complex_arg(data, assert_zcbor_string, __authenticate_manifest_callback_queue); \
	push_retval_arg(cmock_retval, __authenticate_manifest_callback_queue); \
	__cmock_suit_plat_authenticate_manifest_AddCallback(__authenticate_manifest_callback); \
	__cmock_suit_plat_authenticate_manifest_ExpectAndReturn(manifest_component_id, alg_id, key_id, signature, data, cmock_retval); \
	__cmock_suit_plat_authenticate_manifest_IgnoreArg_key_id(); \
	__cmock_suit_plat_authenticate_manifest_IgnoreArg_signature(); \
	__cmock_suit_plat_authenticate_manifest_IgnoreArg_data(); \
	__cmock_suit_plat_authenticate_manifest_IgnoreArg_manifest_component_id(); \
}
int __authenticate_manifest_callback(struct zcbor_string *manifest_component_id, enum suit_cose_alg alg_id, struct zcbor_string *key_id, struct zcbor_string *signature, struct zcbor_string *data, int cmock_num_calls);

#define __cmock_suit_plat_create_component_handle_ExpectComplexArgsAndReturn(component_id, dependency, handle, cmock_retval) { \
	extern complex_arg_q_t __get_component_handle_callback_queue; \
	push_complex_arg(component_id, assert_zcbor_string, __get_component_handle_callback_queue); \
	push_retval_arg(cmock_retval, __get_component_handle_callback_queue); \
	__cmock_suit_plat_create_component_handle_AddCallback(__get_component_handle_callback); \
	__cmock_suit_plat_create_component_handle_ExpectAndReturn(component_id, dependency, handle, cmock_retval); \
	__cmock_suit_plat_create_component_handle_IgnoreArg_component_id(); \
}
int __get_component_handle_callback(struct zcbor_string *component_id, bool dependency, suit_component_t *handle, int cmock_num_calls);

#define __cmock_suit_plat_check_image_match_ExpectComplexArgsAndReturn(image_handle, alg_id, digest, cmock_retval) { \
	extern complex_arg_q_t __check_image_match_callback_queue; \
	push_complex_arg(digest, assert_zcbor_string, __check_image_match_callback_queue); \
	push_retval_arg(cmock_retval, __check_image_match_callback_queue); \
	__cmock_suit_plat_check_image_match_AddCallback(__check_image_match_callback); \
	__cmock_suit_plat_check_image_match_ExpectAndReturn(image_handle, alg_id, digest, cmock_retval); \
	__cmock_suit_plat_check_image_match_IgnoreArg_digest(); \
}
int __check_image_match_callback(suit_component_t image_handle, enum suit_cose_alg alg_id, struct zcbor_string *digest, int cmock_num_calls);

#define __cmock_suit_plat_check_content_ExpectComplexArgsAndReturn(component_handle, content, cmock_retval) { \
	extern complex_arg_q_t __check_content_callback_queue; \
	push_complex_arg(content, assert_zcbor_string, __check_content_callback_queue); \
	push_retval_arg(cmock_retval, __check_content_callback_queue); \
	__cmock_suit_plat_check_content_AddCallback(__check_content_callback); \
	__cmock_suit_plat_check_content_ExpectAndReturn(component_handle, content, cmock_retval); \
	__cmock_suit_plat_check_content_IgnoreArg_content(); \
}
int __check_content_callback(suit_component_t component_handle, struct zcbor_string *content, int cmock_num_calls);

#define __cmock_suit_plat_check_vid_ExpectComplexArgsAndReturn(component_handle, vid_uuid, cmock_retval) { \
	extern complex_arg_q_t __check_vid_callback_queue; \
	push_complex_arg(vid_uuid, assert_zcbor_string, __check_vid_callback_queue); \
	push_retval_arg(cmock_retval, __check_vid_callback_queue); \
	__cmock_suit_plat_check_vid_AddCallback(__check_vid_callback); \
	__cmock_suit_plat_check_vid_ExpectAndReturn(component_handle, vid_uuid, cmock_retval); \
	__cmock_suit_plat_check_vid_IgnoreArg_vid_uuid(); \
}
int __check_vid_callback(suit_component_t component_handle, struct zcbor_string *vid_uuid, int cmock_num_calls);

#define __cmock_suit_plat_check_cid_ExpectComplexArgsAndReturn(component_handle, cid_uuid, cmock_retval) { \
	extern complex_arg_q_t __check_cid_callback_queue; \
	push_complex_arg(cid_uuid, assert_zcbor_string, __check_cid_callback_queue); \
	push_retval_arg(cmock_retval, __check_cid_callback_queue); \
	__cmock_suit_plat_check_cid_AddCallback(__check_cid_callback); \
	__cmock_suit_plat_check_cid_ExpectAndReturn(component_handle, cid_uuid, cmock_retval); \
	__cmock_suit_plat_check_cid_IgnoreArg_cid_uuid(); \
}
int __check_cid_callback(suit_component_t component_handle, struct zcbor_string *cid_uuid, int cmock_num_calls);

#define __cmock_suit_plat_check_did_ExpectComplexArgsAndReturn(component_handle, did_uuid, cmock_retval) { \
	extern complex_arg_q_t __check_did_callback_queue; \
	push_complex_arg(did_uuid, assert_zcbor_string, __check_did_callback_queue); \
	push_retval_arg(cmock_retval, __check_did_callback_queue); \
	__cmock_suit_plat_check_did_AddCallback(__check_did_callback); \
	__cmock_suit_plat_check_did_ExpectAndReturn(component_handle, did_uuid, cmock_retval); \
	__cmock_suit_plat_check_did_IgnoreArg_did_uuid(); \
}
int __check_did_callback(suit_component_t component_handle, struct zcbor_string *did_uuid, int cmock_num_calls);

#define __cmock_suit_plat_authorize_sequence_num_ExpectComplexArgsAndReturn(seq_name, manifest_component_id, seq_num, cmock_retval) { \
	extern complex_arg_q_t __authorize_sequence_num_callback_queue; \
	push_complex_arg(manifest_component_id, assert_zcbor_string, __authorize_sequence_num_callback_queue); \
	push_retval_arg(cmock_retval, __authorize_sequence_num_callback_queue); \
	__cmock_suit_plat_authorize_sequence_num_AddCallback(__authorize_sequence_num_callback); \
	__cmock_suit_plat_authorize_sequence_num_ExpectAndReturn(seq_name, manifest_component_id, seq_num, cmock_retval); \
	__cmock_suit_plat_authorize_sequence_num_IgnoreArg_manifest_component_id(); \
}
int __authorize_sequence_num_callback(enum suit_command_sequence seq_name, struct zcbor_string *manifest_component_id, unsigned int seq_num, int cmock_num_calls);

#define __cmock_suit_plat_authorize_component_id_ExpectComplexArgsAndReturn(manifest_component_id, component_id, cmock_retval) { \
	extern complex_arg_q_t __authorize_component_id_callback_queue; \
	push_complex_arg(manifest_component_id, assert_zcbor_string, __authorize_component_id_callback_queue); \
	push_complex_arg(component_id, assert_zcbor_string, __authorize_component_id_callback_queue); \
	push_retval_arg(cmock_retval, __authorize_component_id_callback_queue); \
	__cmock_suit_plat_authorize_component_id_AddCallback(__authorize_component_id_callback); \
	__cmock_suit_plat_authorize_component_id_ExpectAndReturn(manifest_component_id, component_id, cmock_retval); \
	__cmock_suit_plat_authorize_component_id_IgnoreArg_manifest_component_id(); \
	__cmock_suit_plat_authorize_component_id_IgnoreArg_component_id(); \
}
int __authorize_component_id_callback(struct zcbor_string *manifest_component_id, struct zcbor_string *component_id, int cmock_num_calls);

#define __cmock_suit_plat_check_fetch_ExpectComplexArgsAndReturn(dst_handle, uri, manifest_component_id, enc_info, cmock_retval) { \
	extern complex_arg_q_t __check_fetch_callback_queue; \
	push_complex_arg(uri, assert_zcbor_string, __check_fetch_callback_queue); \
	push_complex_arg(manifest_component_id, assert_zcbor_string, __check_fetch_callback_queue); \
	push_retval_arg(cmock_retval, __check_fetch_callback_queue); \
	__cmock_suit_plat_check_fetch_AddCallback(__check_fetch_callback); \
	__cmock_suit_plat_check_fetch_ExpectAndReturn(dst_handle, uri, manifest_component_id, enc_info, cmock_retval); \
	__cmock_suit_plat_check_fetch_IgnoreArg_uri(); \
	__cmock_suit_plat_check_fetch_IgnoreArg_manifest_component_id(); \
}
int __check_fetch_callback(suit_component_t dst_handle, struct zcbor_string *uri, struct zcbor_string *manifest_component_id, struct suit_encryption_info *enc_info, int cmock_num_calls);

#define __cmock_suit_plat_fetch_ExpectComplexArgsAndReturn(dst_handle, uri, manifest_component_id, enc_info, cmock_retval) { \
	extern complex_arg_q_t __fetch_callback_queue; \
	push_complex_arg(uri, assert_zcbor_string, __fetch_callback_queue); \
	push_complex_arg(manifest_component_id, assert_zcbor_string, __fetch_callback_queue); \
	push_retval_arg(cmock_retval, __fetch_callback_queue); \
	__cmock_suit_plat_fetch_AddCallback(__fetch_callback); \
	__cmock_suit_plat_fetch_ExpectAndReturn(dst_handle, uri, manifest_component_id, enc_info, cmock_retval); \
	__cmock_suit_plat_fetch_IgnoreArg_uri(); \
	__cmock_suit_plat_fetch_IgnoreArg_manifest_component_id(); \
}
int __fetch_callback(suit_component_t dst_handle, struct zcbor_string *uri, struct zcbor_string *manifest_component_id, struct suit_encryption_info *enc_info, int cmock_num_calls);

#define __cmock_suit_plat_check_fetch_integrated_ExpectComplexArgsAndReturn(dst_handle, payload, manifest_component_id, enc_info, cmock_retval) { \
	extern complex_arg_q_t __check_fetch_integrated_callback_queue; \
	push_complex_arg(payload, assert_zcbor_string, __check_fetch_integrated_callback_queue); \
	push_complex_arg(manifest_component_id, assert_zcbor_string, __check_fetch_integrated_callback_queue); \
	push_retval_arg(cmock_retval, __check_fetch_integrated_callback_queue); \
	__cmock_suit_plat_check_fetch_integrated_AddCallback(__check_fetch_integrated_callback); \
	__cmock_suit_plat_check_fetch_integrated_ExpectAndReturn(dst_handle, payload, manifest_component_id, enc_info, cmock_retval); \
	__cmock_suit_plat_check_fetch_integrated_IgnoreArg_payload(); \
	__cmock_suit_plat_check_fetch_integrated_IgnoreArg_manifest_component_id(); \
}
int __check_fetch_integrated_callback(suit_component_t dst_handle, struct zcbor_string *payload, struct zcbor_string *manifest_component_id, struct suit_encryption_info *enc_info, int cmock_num_calls);

#define __cmock_suit_plat_fetch_integrated_ExpectComplexArgsAndReturn(dst_handle, payload, manifest_component_id, enc_info, cmock_retval) { \
	extern complex_arg_q_t __fetch_integrated_callback_queue; \
	push_complex_arg(payload, assert_zcbor_string, __fetch_integrated_callback_queue); \
	push_complex_arg(manifest_component_id, assert_zcbor_string, __fetch_integrated_callback_queue); \
	push_retval_arg(cmock_retval, __fetch_integrated_callback_queue); \
	__cmock_suit_plat_fetch_integrated_AddCallback(__fetch_integrated_callback); \
	__cmock_suit_plat_fetch_integrated_ExpectAndReturn(dst_handle, payload, manifest_component_id, enc_info, cmock_retval); \
	__cmock_suit_plat_fetch_integrated_IgnoreArg_payload(); \
	__cmock_suit_plat_fetch_integrated_IgnoreArg_manifest_component_id(); \
}
int __fetch_integrated_callback(suit_component_t dst_handle, struct zcbor_string *payload, struct zcbor_string *manifest_component_id, struct suit_encryption_info *enc_info, int cmock_num_calls);

#define __cmock_suit_plat_check_copy_ExpectComplexArgsAndReturn(dst_handle, src_handle, manifest_component_id, enc_info, cmock_retval) { \
	extern complex_arg_q_t __check_copy_callback_queue; \
	push_complex_arg(manifest_component_id, assert_zcbor_string, __check_copy_callback_queue); \
	push_retval_arg(cmock_retval, __check_copy_callback_queue); \
	__cmock_suit_plat_check_copy_AddCallback(__check_copy_callback); \
	__cmock_suit_plat_check_copy_ExpectAndReturn(dst_handle, src_handle, manifest_component_id, enc_info, cmock_retval); \
	__cmock_suit_plat_check_copy_IgnoreArg_manifest_component_id(); \
}
int __check_copy_callback(suit_component_t dst_handle, suit_component_t src_handle, struct zcbor_string *manifest_component_id, struct suit_encryption_info *enc_info, int cmock_num_calls);

#define __cmock_suit_plat_copy_ExpectComplexArgsAndReturn(dst_handle, src_handle, manifest_component_id, enc_info, cmock_retval) { \
	extern complex_arg_q_t __copy_callback_queue; \
	push_complex_arg(manifest_component_id, assert_zcbor_string, __copy_callback_queue); \
	push_retval_arg(cmock_retval, __copy_callback_queue); \
	__cmock_suit_plat_copy_AddCallback(__copy_callback); \
	__cmock_suit_plat_copy_ExpectAndReturn(dst_handle, src_handle, manifest_component_id, enc_info, cmock_retval); \
	__cmock_suit_plat_copy_IgnoreArg_manifest_component_id(); \
}
int __copy_callback(suit_component_t dst_handle, suit_component_t src_handle, struct zcbor_string *manifest_component_id, struct suit_encryption_info *enc_info, int cmock_num_calls);

#define __cmock_suit_plat_sequence_completed_ExpectComplexArgsAndReturn(seq_name, manifest_component_id, envelope_str, envelope_len, cmock_retval) { \
	extern complex_arg_q_t __sequence_completed_callback_queue; \
	push_complex_arg(manifest_component_id, assert_zcbor_string, __sequence_completed_callback_queue); \
	push_retval_arg(cmock_retval, __sequence_completed_callback_queue); \
	__cmock_suit_plat_sequence_completed_AddCallback(__sequence_completed_callback); \
	__cmock_suit_plat_sequence_completed_ExpectAndReturn(seq_name, manifest_component_id, envelope_str, envelope_len, cmock_retval); \
	__cmock_suit_plat_sequence_completed_IgnoreArg_manifest_component_id(); \
}
int __sequence_completed_callback(enum suit_command_sequence seq_name, struct zcbor_string *manifest_component_id, const uint8_t *envelope_str, size_t envelope_len, int cmock_num_calls);

#define __cmock_suit_plat_check_write_ExpectComplexArgsAndReturn(dst_handle, content, manifest_component_id, enc_info, cmock_retval) { \
	extern complex_arg_q_t __check_write_callback_queue; \
	push_complex_arg(content, assert_zcbor_string, __check_write_callback_queue); \
	push_complex_arg(manifest_component_id, assert_zcbor_string, __check_write_callback_queue); \
	push_retval_arg(cmock_retval, __check_write_callback_queue); \
	__cmock_suit_plat_check_write_AddCallback(__check_write_callback); \
	__cmock_suit_plat_check_write_ExpectAndReturn(dst_handle, content, manifest_component_id, enc_info, cmock_retval); \
	__cmock_suit_plat_check_write_IgnoreArg_content(); \
	__cmock_suit_plat_check_write_IgnoreArg_manifest_component_id(); \
}
int __check_write_callback(suit_component_t dst_handle, struct zcbor_string *content, struct zcbor_string *manifest_component_id, struct suit_encryption_info *enc_info, int cmock_num_calls);

#define __cmock_suit_plat_write_ExpectComplexArgsAndReturn(dst_handle, content, manifest_component_id, enc_info, cmock_retval) { \
	extern complex_arg_q_t __write_callback_queue; \
	push_complex_arg(content, assert_zcbor_string, __write_callback_queue); \
	push_complex_arg(manifest_component_id, assert_zcbor_string, __write_callback_queue); \
	push_retval_arg(cmock_retval, __write_callback_queue); \
	__cmock_suit_plat_write_AddCallback(__write_callback); \
	__cmock_suit_plat_write_ExpectAndReturn(dst_handle, content, manifest_component_id, enc_info, cmock_retval); \
	__cmock_suit_plat_write_IgnoreArg_content(); \
	__cmock_suit_plat_write_IgnoreArg_manifest_component_id(); \
}
int __write_callback(suit_component_t dst_handle, struct zcbor_string *content, struct zcbor_string *manifest_component_id, struct suit_encryption_info *enc_info, int cmock_num_calls);

#define __cmock_suit_plat_authorize_process_dependency_ExpectComplexArgsAndReturn(parent_component_id, child_component_id, seq_name, cmock_retval) { \
	extern complex_arg_q_t __dependency_seq_authorize_callback_queue; \
	push_complex_arg(parent_component_id, assert_zcbor_string, __dependency_seq_authorize_callback_queue); \
	push_complex_arg(child_component_id, assert_zcbor_string, __dependency_seq_authorize_callback_queue); \
	push_retval_arg(cmock_retval, __dependency_seq_authorize_callback_queue); \
	__cmock_suit_plat_authorize_process_dependency_AddCallback(__dependency_seq_authorize_callback); \
	__cmock_suit_plat_authorize_process_dependency_ExpectAndReturn(parent_component_id, child_component_id, seq_name, cmock_retval); \
	__cmock_suit_plat_authorize_process_dependency_IgnoreArg_parent_component_id(); \
	__cmock_suit_plat_authorize_process_dependency_IgnoreArg_child_component_id(); \
}
int __dependency_seq_authorize_callback(struct zcbor_string *parent_component_id, struct zcbor_string *child_component_id, enum suit_command_sequence seq_name, int cmock_num_calls);

#endif /* _SUIT_PLATFORM_MOCK_EXT_H */
```

## src/manifest.c
```c
/*
 * Copyright (c) 2023 Nordic Semiconductor ASA
 *
 * SPDX-License-Identifier: LicenseRef-Nordic-5-Clause
 */

#include <stdint.h>
#include <stddef.h>

/** @brief Sample SUIT envelope that fetches integrated payload into the executable slot.
 *
 * @details This envelope contains 256-byte random numbers attached as an integrated
 *          payload and fetched directly into the memory-mapped region during install step.
 *          The envelope has been signed using the manifest/key_private.pem key.
 */
uint8_t manifest_buf[] = {
	0xD8, 0x6B, 0xA4, 0x02, 0x58, 0x73, 0x82, 0x58,
	0x24, 0x82, 0x2F, 0x58, 0x20, 0xAD, 0xD7, 0xDD,
	0x3E, 0x37, 0x4D, 0x38, 0xF3, 0x8A, 0x7E, 0x4F,
	0xF2, 0x60, 0x12, 0x42, 0xAA, 0x2D, 0xF2, 0x46,
	0x3B, 0x8F, 0xEC, 0xA3, 0x60, 0xEA, 0x37, 0x5F,
	0x50, 0xEA, 0xB3, 0xBF, 0x7D, 0x58, 0x4A, 0xD2,
	0x84, 0x43, 0xA1, 0x01, 0x26, 0xA0, 0xF6, 0x58,
	0x40, 0x0A, 0xC7, 0x7A, 0x88, 0xA2, 0x9E, 0x45,
	0x5D, 0x6A, 0x9D, 0x6E, 0xC9, 0x04, 0x77, 0x24,
	0x8B, 0x8E, 0x5E, 0x2F, 0xFE, 0x9C, 0xF0, 0x22,
	0x4F, 0xB7, 0x7A, 0x3C, 0x36, 0xA0, 0xF0, 0x79,
	0xBB, 0x2B, 0x78, 0xB2, 0xEA, 0xEB, 0x20, 0x00,
	0x2B, 0x19, 0x3B, 0xE9, 0xA1, 0x3E, 0xFB, 0x83,
	0xF6, 0xA8, 0x7A, 0x03, 0x74, 0x2D, 0xF1, 0x08,
	0x4E, 0x5B, 0xD0, 0x4D, 0x45, 0xF9, 0x97, 0x39,
	0xC0, 0x03, 0x58, 0xAE, 0xA7, 0x01, 0x01, 0x02,
	0x01, 0x03, 0x58, 0x64, 0xA2, 0x02, 0x81, 0x82,
	0x41, 0x58, 0x44, 0x1E, 0x05, 0x40, 0x00, 0x04,
	0x58, 0x56, 0x86, 0x14, 0xA4, 0x01, 0x50, 0x76,
	0x17, 0xDA, 0xA5, 0x71, 0xFD, 0x5A, 0x85, 0x8F,
	0x94, 0xE2, 0x8D, 0x73, 0x5C, 0xE9, 0xF4, 0x02,
	0x50, 0xD6, 0x22, 0xBA, 0xFD, 0x43, 0x37, 0x51,
	0x85, 0x90, 0xBC, 0x63, 0x68, 0xCD, 0xA7, 0xFB,
	0xCA, 0x03, 0x58, 0x24, 0x82, 0x2F, 0x58, 0x20,
	0x5F, 0xC3, 0x54, 0xBF, 0x8E, 0x8C, 0x50, 0xFB,
	0x4F, 0xBC, 0x2C, 0xFA, 0xEB, 0x04, 0x53, 0x41,
	0xC9, 0x80, 0x6D, 0xEA, 0xBD, 0xCB, 0x41, 0x54,
	0xFB, 0x79, 0xCC, 0xA4, 0xF0, 0xC9, 0x8C, 0x12,
	0x0E, 0x19, 0x01, 0x00, 0x01, 0x0F, 0x02, 0x0F,
	0x07, 0x43, 0x82, 0x03, 0x0F, 0x09, 0x43, 0x82,
	0x17, 0x02, 0x14, 0x51, 0x86, 0x14, 0xA1, 0x15,
	0x68, 0x23, 0x61, 0x70, 0x70, 0x2E, 0x62, 0x69,
	0x6E, 0x15, 0x02, 0x03, 0x0F, 0x17, 0x82, 0x2F,
	0x58, 0x20, 0x4E, 0xDC, 0x09, 0xC1, 0x4D, 0x19,
	0xF1, 0x56, 0x0C, 0x9A, 0xCE, 0x62, 0x64, 0xA5,
	0x3D, 0x86, 0xF8, 0x90, 0x73, 0x70, 0x49, 0x94,
	0x63, 0x48, 0x77, 0x00, 0x7F, 0x1E, 0x04, 0x27,
	0x2E, 0xE5, 0x17, 0x58, 0x8A, 0xA1, 0x82, 0x41,
	0x58, 0x44, 0x1E, 0x05, 0x40, 0x00, 0xA6, 0x01,
	0x78, 0x18, 0x4E, 0x6F, 0x72, 0x64, 0x69, 0x63,
	0x20, 0x53, 0x65, 0x6D, 0x69, 0x63, 0x6F, 0x6E,
	0x64, 0x75, 0x63, 0x74, 0x6F, 0x72, 0x20, 0x41,
	0x53, 0x41, 0x02, 0x6E, 0x6E, 0x52, 0x46, 0x35,
	0x34, 0x32, 0x30, 0x5F, 0x63, 0x70, 0x75, 0x61,
	0x70, 0x70, 0x03, 0x6E, 0x6E, 0x6F, 0x72, 0x64,
	0x69, 0x63, 0x73, 0x65, 0x6D, 0x69, 0x2E, 0x63,
	0x6F, 0x6D, 0x04, 0x78, 0x1D, 0x54, 0x68, 0x65,
	0x20, 0x6E, 0x52, 0x46, 0x35, 0x33, 0x38, 0x34,
	0x30, 0x20, 0x61, 0x70, 0x70, 0x6C, 0x69, 0x63,
	0x61, 0x74, 0x69, 0x6F, 0x6E, 0x20, 0x63, 0x6F,
	0x72, 0x65, 0x05, 0x78, 0x1A, 0x53, 0x61, 0x6D,
	0x70, 0x6C, 0x65, 0x20, 0x61, 0x70, 0x70, 0x6C,
	0x69, 0x63, 0x61, 0x74, 0x69, 0x6F, 0x6E, 0x20,
	0x63, 0x6F, 0x72, 0x65, 0x20, 0x46, 0x57, 0x06,
	0x66, 0x76, 0x31, 0x2E, 0x30, 0x2E, 0x30, 0x68,
	0x23, 0x61, 0x70, 0x70, 0x2E, 0x62, 0x69, 0x6E,
	0x59, 0x01, 0x00, 0xC7, 0x9C, 0xAB, 0x9D, 0xE8,
	0x33, 0x7F, 0x30, 0x14, 0xEB, 0xAC, 0x02, 0xAF,
	0x26, 0x01, 0x5E, 0x80, 0x6D, 0x88, 0xA1, 0xDB,
	0x11, 0xA7, 0x31, 0xDF, 0xA6, 0xEC, 0xCB, 0x9B,
	0x48, 0x0D, 0xC8, 0x34, 0x40, 0x6D, 0x30, 0x86,
	0x7D, 0xE8, 0x1B, 0xEC, 0x3C, 0xF5, 0x40, 0xD0,
	0x48, 0x18, 0x82, 0x11, 0x9D, 0x7C, 0x3F, 0x6C,
	0xE5, 0x8F, 0xF1, 0xD3, 0x5D, 0xE1, 0x51, 0xF7,
	0x6A, 0x0F, 0xAF, 0x0B, 0xBD, 0x4C, 0x5F, 0xA5,
	0x34, 0x1A, 0x66, 0xDB, 0x22, 0xEC, 0x63, 0xED,
	0x4B, 0xAB, 0xC7, 0xC8, 0xF7, 0x59, 0xD8, 0xD6,
	0x9E, 0xEC, 0x71, 0x1B, 0x24, 0x20, 0xB9, 0xAE,
	0xE1, 0x3B, 0xFC, 0xAE, 0xB8, 0x77, 0xAC, 0xA4,
	0x57, 0x34, 0x97, 0x84, 0x4F, 0x58, 0xD5, 0x68,
	0x08, 0x6F, 0xE3, 0x9C, 0x7E, 0x1B, 0xD7, 0x38,
	0x22, 0x98, 0x48, 0xF8, 0x7A, 0x67, 0xB2, 0xD9,
	0xAC, 0xC5, 0x34, 0xC1, 0x27, 0x82, 0x8E, 0x42,
	0x79, 0x84, 0x21, 0x37, 0x4C, 0x41, 0x4A, 0x0F,
	0xE2, 0x7F, 0xA0, 0x6A, 0x19, 0x13, 0x3D, 0x52,
	0x22, 0x7F, 0xD6, 0x2F, 0x71, 0x12, 0x76, 0xAB,
	0x25, 0x9C, 0xFC, 0x67, 0x08, 0x03, 0x7C, 0xDB,
	0x18, 0xE6, 0x45, 0xF8, 0x99, 0xC2, 0x9E, 0x2C,
	0xE3, 0x9B, 0x25, 0xA9, 0x7B, 0x09, 0xFF, 0x00,
	0x57, 0x26, 0x08, 0x0A, 0x11, 0x42, 0xCF, 0x82,
	0xA2, 0x6B, 0x2A, 0x99, 0xF9, 0x71, 0x9D, 0x14,
	0x19, 0x5C, 0x5C, 0x78, 0x31, 0x60, 0x42, 0x4A,
	0x18, 0x1F, 0xEC, 0x78, 0x6A, 0x9A, 0x7C, 0x4F,
	0xCF, 0xE8, 0x5A, 0x29, 0x65, 0xCD, 0x01, 0x3B,
	0x6D, 0x53, 0xBB, 0xC6, 0xDB, 0xDA, 0xD5, 0x8F,
	0xF7, 0xF4, 0xD9, 0xB9, 0x0A, 0x03, 0x4B, 0xFF,
	0x33, 0xAB, 0x3B, 0xC5, 0xAF, 0xD0, 0xB8, 0x2C,
	0x0F, 0x6A, 0xA9, 0x11, 0xB0, 0xE8, 0x57, 0x8C,
	0x92, 0x53, 0x81
};
const size_t manifest_len = sizeof(manifest_buf);
```

## src/suit_platform_mock_ext.c
```c
/*
 * Copyright (c) 2022 Nordic Semiconductor ASA
 *
 * SPDX-License-Identifier: LicenseRef-Nordic-5-Clause
 */

#include "suit_platform_mock_ext.h"


void assert_zcbor_string(void *p1, void *p2)
{
	struct zcbor_string *a = (struct zcbor_string *)p1;
	struct zcbor_string *b = (struct zcbor_string *)p2;

	/* Do not assert if both pointers are set to NULL */
	if ((a != NULL) || (b != NULL)) {
		TEST_ASSERT_NOT_NULL_MESSAGE((a), "Expected ZCBOR string pointer was not passed");
		TEST_ASSERT_NOT_NULL_MESSAGE((b), "ZCBOR string pointer was not passed");

		TEST_ASSERT_EQUAL_MESSAGE((a)->len, (b)->len, "ZCBOR string length does not match");
		if ((a)->len != 0) {
			TEST_ASSERT_NOT_NULL_MESSAGE((a)->value, "expected ZCBOR string value is not set");
			TEST_ASSERT_NOT_NULL_MESSAGE((b)->value, "ZCBOR string value is not set");
			TEST_ASSERT_EQUAL_MEMORY_MESSAGE((a)->value, (b)->value, (a)->len, "ZCBOR string value does not match");
		}
	}
}

COMPLEX_ARG_Q_DEFINE(__check_digest_callback_queue);
int __check_digest_callback(enum suit_cose_alg alg_id, struct zcbor_string* digest, struct zcbor_string* payload, int cmock_num_calls)
{
	(void)assert_complex_arg(&__check_digest_callback_queue, digest);
	(void)assert_complex_arg(&__check_digest_callback_queue, payload);
	return assert_complex_arg(&__check_digest_callback_queue, NULL);
}

COMPLEX_ARG_Q_DEFINE(__authenticate_manifest_callback_queue);
int __authenticate_manifest_callback(struct zcbor_string* manifest_component_id, enum suit_cose_alg alg_id, struct zcbor_string* key_id, struct zcbor_string* signature, struct zcbor_string* data, int cmock_num_calls)
{
	(void)assert_complex_arg(&__authenticate_manifest_callback_queue, manifest_component_id);
	(void)assert_complex_arg(&__authenticate_manifest_callback_queue, key_id);
	(void)assert_complex_arg(&__authenticate_manifest_callback_queue, signature);
	(void)assert_complex_arg(&__authenticate_manifest_callback_queue, data);
	return assert_complex_arg(&__authenticate_manifest_callback_queue, NULL);
}

COMPLEX_ARG_Q_DEFINE(__get_component_handle_callback_queue);
int __get_component_handle_callback(struct zcbor_string* component_id, suit_component_t* component_handle, int cmock_num_calls)
{
	(void)assert_complex_arg(&__get_component_handle_callback_queue, component_id);
	return assert_complex_arg(&__get_component_handle_callback_queue, NULL);
}

COMPLEX_ARG_Q_DEFINE(__check_image_match_callback_queue);
int __check_image_match_callback(suit_component_t image_handle, enum suit_cose_alg alg_id, struct zcbor_string* digest, int cmock_num_calls)
{
	(void)assert_complex_arg(&__check_image_match_callback_queue, digest);
	return assert_complex_arg(&__check_image_match_callback_queue, NULL);
}

COMPLEX_ARG_Q_DEFINE(__check_vid_callback_queue);
int __check_vid_callback(suit_component_t component_handle, struct zcbor_string* vid_uuid, int cmock_num_calls)
{
	(void)assert_complex_arg(&__check_vid_callback_queue, vid_uuid);
	return assert_complex_arg(&__check_vid_callback_queue, NULL);
}

COMPLEX_ARG_Q_DEFINE(__check_cid_callback_queue);
int __check_cid_callback(suit_component_t component_handle, struct zcbor_string* cid_uuid, int cmock_num_calls)
{
	(void)assert_complex_arg(&__check_cid_callback_queue, cid_uuid);
	return assert_complex_arg(&__check_cid_callback_queue, NULL);
}

COMPLEX_ARG_Q_DEFINE(__check_did_callback_queue);
int __check_did_callback(suit_component_t component_handle, struct zcbor_string* did_uuid, int cmock_num_calls)
{
	(void)assert_complex_arg(&__check_did_callback_queue, did_uuid);
	return assert_complex_arg(&__check_did_callback_queue, NULL);
}

COMPLEX_ARG_Q_DEFINE(__authorize_component_id_callback_queue);
int __authorize_component_id_callback(struct zcbor_string *manifest_component_id, struct zcbor_string *component_id, int cmock_num_calls)
{
	(void)assert_complex_arg(&__authorize_component_id_callback_queue, manifest_component_id);
	(void)assert_complex_arg(&__authorize_component_id_callback_queue, component_id);
	return assert_complex_arg(&__authorize_component_id_callback_queue, NULL);
}

COMPLEX_ARG_Q_DEFINE(__check_fetch_callback_queue);
int __check_fetch_callback(suit_component_t dst_handle, struct zcbor_string* uri, int cmock_num_calls)
{
	(void)assert_complex_arg(&__check_fetch_callback_queue, uri);
	return assert_complex_arg(&__check_fetch_callback_queue, NULL);
}

COMPLEX_ARG_Q_DEFINE(__fetch_callback_queue);
int __fetch_callback(suit_component_t dst_handle, struct zcbor_string* uri, int cmock_num_calls)
{
	(void)assert_complex_arg(&__fetch_callback_queue, uri);
	return assert_complex_arg(&__fetch_callback_queue, NULL);
}

COMPLEX_ARG_Q_DEFINE(__check_fetch_integrated_callback_queue);
int __check_fetch_integrated_callback(suit_component_t dst_handle, struct zcbor_string* payload, int cmock_num_calls)
{
	(void)assert_complex_arg(&__check_fetch_integrated_callback_queue, payload);
	return assert_complex_arg(&__check_fetch_integrated_callback_queue, NULL);
}

COMPLEX_ARG_Q_DEFINE(__fetch_integrated_callback_queue);
int __fetch_integrated_callback(suit_component_t dst_handle, struct zcbor_string* payload, int cmock_num_calls)
{
	(void)assert_complex_arg(&__fetch_integrated_callback_queue, payload);
	return assert_complex_arg(&__fetch_integrated_callback_queue, NULL);
}
```
