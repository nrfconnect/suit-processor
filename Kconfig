## Kconfig
```kconfig
# Copyright (c) 2022 Nordic Semiconductor ASA
# SPDX-License-Identifier: Apache-2.0

config ZEPHYR_SUIT_PROCESSOR_MODULE
	bool

config SUIT_PROCESSOR
	bool "SUIT Manifest Processor library"
	help
	  Library for processing SUIT envelope 

if SUIT_PROCESSOR

# This is just a test, use real configs here
config SUIT_PROCESSOR_EXAMPLE
	bool "Example config for suit-processor"
	help
	  Do whatever you like

endif # SUIT_PROCESSOR

config APP_LINK_WITH_SUIT_PROCESSOR_INTERFACE
	bool
	default y if SUIT_PROCESSOR
```

## tests/integration/fetch_integrated_payload/testcase.yaml
```yaml
tests:
  suit-processor.integration.fetch_integrated_payload:
    platform_allow: nrf52840dk_nrf52840
    tags: suit-processor integrated-payload fetch
```

## tests/unit/bootstrap_envelope/testcase.yaml
```yaml
tests:
  suit-processor.unit.bootstrap_envelope:
    platform_allow:
      - native_sim
      - native_sim/native/64
      - mps2/an521/cpu0
    tags: suit-processor run-command-sequence
```

## tests/unit/decoder/testcase.yaml
```yaml
tests:
  suit-processor.unit.decoder:
    platform_allow:
      - native_sim
      - native_sim/native/64
      - mps2/an521/cpu0
    tags: suit-processor suit-decoder
```

## tests/unit/fetch_integrated_manifests/testcase.yaml
```yaml
tests:
  suit-processor.unit.fetch_integrated_manifests:
    platform_allow:
      - native_sim
      - native_sim/native/64
      - mps2/an521/cpu0
    tags: suit-processor integrated-manifest fetch
```

## tests/unit/fetch_integrated_payload/testcase.yaml
```yaml
tests:
  suit-processor.unit.fetch_integrated_payload:
    platform_allow:
      - native_sim
      - native_sim/native/64
      - mps2/an521/cpu0
    tags: suit-processor integrated-payload fetch
```

## tests/unit/manifest/testcase.yaml
```yaml
tests:
  suit-processor.unit.manifest:
    platform_allow: native_sim native_sim/native/64 mps2_an521
    tags: suit-processor suit-manifest
```

## tests/unit/manifest_metadata/testcase.yaml
```yaml
tests:
  suit-processor.unit.menifest_metadata:
    platform_allow:
      - native_sim
      - native_sim/native/64
      - mps2/an521/cpu0
    tags: suit-processor suit-manifest-metadata
```

## tests/unit/nested_seq/testcase.yaml
```yaml
tests:
  suit-processor.unit.nested_seq:
    platform_allow: native_sim native_sim/native/64 mps2_an521
    tags: suit-processor run-command-sequence
```

## tests/unit/seq_execution/testcase.yaml
```yaml
tests:
  suit-processor.unit.seq_execution:
    platform_allow:
      - native_sim
      - native_sim/native/64
      - mps2/an521/cpu0
    tags: suit-processor suit-schedule-execution
```

## tests/unit/seq_validation/testcase.yaml
```yaml
tests:
  suit-processor.unit.seq_validation:
    platform_allow:
      - native_sim
      - native_sim/native/64
      - mps2/an521/cpu0
    tags: suit-processor suit-schedule-validation
```

## tests/unit/try_each/testcase.yaml
```yaml
tests:
  suit-processor.unit.try_each:
    platform_allow:
      - native_sim
      - native_sim/native/64
      - mps2/an521/cpu0
    tags: suit-processor try-each
```
